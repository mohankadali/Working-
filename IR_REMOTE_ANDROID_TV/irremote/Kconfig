## IR_REMOTE_ANDROID_TV/irremote/Kconfig
```kconfig
config ARCH_HAVE_CUSTOM_GPIO_H
        bool
        help
          Selecting this config option from the architecture Kconfig allows
          the architecture to provide a custom asm/gpio.h implementation
          overriding the default implementations.  New uses of this are
          strongly discouraged.


menu "MOHAN IR_REMOTE"
        config MOHAN
                tristate "MOHAN_IR_REMOTE SUPPORT"
                select RT_MUTEXES
                select IRQ_DOMAIN
endmenu
```

## spi_module/spi_adc/kconfig
```kconfig
 menu "SPI support"
 
 config SPI
 	tristate "SPI support"
         default false
 	help
 	  Say Y if you need to enable SPI support on your kernel
 
 config SPI_DEBUG
 	bool "SPI debug output" 
 	depends on SPI 
 	default false 
 	help 
           Say Y there if you'd like to see debug output from SPI drivers.
 	  If unsure, say N
 	
 config SPI_CHARDEV
 	tristate "SPI device interface"
 	depends on SPI
 	help
 	  Say Y here to use spi-* device files, usually found in the /dev
 	  directory on your system.  They make it possible to have user-space
 	  programs use the SPI bus. 
 	  This support is also available as a module.  If so, the module 
 	  will be called spi-dev.
 
 endmenu
 
```
